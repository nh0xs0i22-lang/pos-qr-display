## firmware/sdkconfig.defaults
```kconfig
# ESP32-S3 target
CONFIG_IDF_TARGET="esp32s3"

# Flash: 16 MB
CONFIG_ESPTOOLPY_FLASHSIZE_16MB=y
CONFIG_PARTITION_TABLE_SINGLE_APP_LARGE=y

# CPU: 240 MHz (needed for 40 MHz pixel clock)
CONFIG_ESP_DEFAULT_CPU_FREQ_MHZ_240=y

# ── PSRAM: Octal, 80 MHz ──────────────────────────
CONFIG_SPIRAM=y
CONFIG_SPIRAM_MODE_OCT=y
CONFIG_SPIRAM_SPEED_80M=y
CONFIG_SPIRAM_TYPE_AUTO=y
CONFIG_SPIRAM_BOOT_INIT=y
CONFIG_SPIRAM_USE_MALLOC=y
CONFIG_SPIRAM_MALLOC_ALWAYSINTERNAL=16384
CONFIG_SPIRAM_MALLOC_RESERVE_INTERNAL=32768
CONFIG_SPIRAM_ALLOW_STACK_EXTERNAL_MEMORY=y
CONFIG_SPIRAM_MEMTEST=y

# ── XIP from PSRAM (reduces flash reads → fewer cache-disable events) ──
CONFIG_SPIRAM_XIP_FROM_PSRAM=y
CONFIG_SPIRAM_FETCH_INSTRUCTIONS=y
CONFIG_SPIRAM_RODATA=y

# ── Data cache: 64-byte line (required for Oct PSRAM @ 80 MHz) ──
CONFIG_ESP32S3_DATA_CACHE_32KB=y
CONFIG_ESP32S3_DATA_CACHE_8WAYS=y
CONFIG_ESP32S3_DATA_CACHE_LINE_64B=y

# ── RGB LCD: stable coexistence with WiFi/NVS ─────
# ISR must NOT be IRAM-safe (it reads PSRAM through cache)
# CONFIG_LCD_RGB_ISR_IRAM_SAFE is not set
# Restart DMA cleanly after any underrun from cache-disable
CONFIG_LCD_RGB_RESTART_IN_VSYNC=y

# ── LVGL 8.4 ──────────────────────────────────────
CONFIG_LV_COLOR_DEPTH_16=y
CONFIG_LV_MEM_SIZE_KILOBYTES=48
CONFIG_LV_MEMCPY_MEMSET_STD=y
CONFIG_LV_FONT_MONTSERRAT_14=y
CONFIG_LV_FONT_MONTSERRAT_20=y
CONFIG_LV_FONT_MONTSERRAT_48=y
CONFIG_LV_FONT_DEFAULT_MONTSERRAT_20=y
CONFIG_LV_USE_QRCODE=y
CONFIG_LV_USE_SNAPSHOT=y
```
